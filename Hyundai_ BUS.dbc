VERSION ""

NS_ :

BS_:

BU_: XXX

BO_ 418384139 SAS: 8 XXX
 SG_ SAS_Angle : 0|16@1- (0.1,0) [-3276.8|3276.7] "Deg" XXX
