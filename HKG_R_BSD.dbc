VERSION ""

NS_ :

BS_:

BU_: XXX

BO_ 2 NEW_MSG_1: 8 XXX
 SG_ Counter : 0|4@1+ (1,0) [0|15] "" XXX
 SG_ Master_Counter : 32|24@1+ (1,0) [0|16777215] "" XXX

BO_ 4 NEW_MSG_2: 8 XXX
 SG_ Counter : 0|4@1+ (1,0) [0|15] "" XXX
 SG_ Master_Counter : 39|24@0+ (1,0) [0|16777215] "" XXX
